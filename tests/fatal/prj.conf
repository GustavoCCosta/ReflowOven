## CMakeLists.txt
```
# SPDX-License-Identifier: Apache-2.0

cmake_minimum_required(VERSION 3.20.0)

# Same reason as tests/boot: reuse the application's Kconfig instead of
# restating the CONFIG_REFLOW_* symbols heater.c needs, so the test cannot
# drift away from the defaults the firmware ships with.
set(KCONFIG_ROOT ${CMAKE_CURRENT_SOURCE_DIR}/../../Kconfig)

find_package(Zephyr REQUIRED HINTS $ENV{ZEPHYR_BASE})
project(reflow_fatal_tests LANGUAGES C)

set(SRC ${CMAKE_CURRENT_SOURCE_DIR}/../../src)

# heater.c and fatal.c, and no control thread: the property under test is that
# the gate goes low on the fatal path itself, with nothing else running. Linking
# controller.c would put a control loop in the image and its stale-duty disarm
# could drive the gate low for reasons that have nothing to do with this patch.
target_sources(app PRIVATE
  ${SRC}/core/heater.c
  ${SRC}/core/fatal.c
)

# The two scenarios need different mains: one is a ztest image, the other is a
# plain application that panics and is judged by the console harness. ztest's
# own k_sys_fatal_error_handler (CONFIG_ZTEST_FATAL_HOOK) is a strong symbol and
# would collide with fatal.c, so the real-fault scenario cannot be a ztest.
if(CONFIG_ZTEST)
  target_sources(app PRIVATE src/main.c)
else()
  target_sources(app PRIVATE src/panic.c)
endif()

target_include_directories(app PRIVATE ${SRC} ${SRC}/core)
```

## prj.conf
```kconfig
# CONFIG_ZTEST is set per scenario in testcase.yaml, not here: reflow.fatal.panic
# is a plain application, because ztest's fatal hook collides with fatal.c.

CONFIG_GPIO=y
CONFIG_GPIO_EMUL=y

# The control core is not in this image; the optional features must stay out too,
# or their Kconfig dependencies pull in subsystems this test has no board for.
CONFIG_REFLOW_SHELL=n
CONFIG_REFLOW_UI_DISPLAY=n
CONFIG_REFLOW_UI_INPUT=n
CONFIG_REFLOW_NET=n

# The evidence that the cut happened is a log line, so the image needs the
# same logging the firmware ships with: CONFIG_LOG=y and the app at INF, as in
# the application prj.conf. Deferred mode is the default and is what the
# rpi_pico2 build uses, so LOG_PANIC() flushing from the fatal path is part of
# what this scenario measures rather than something configured away.
CONFIG_LOG=y
CONFIG_REFLOW_LOG_LEVEL_INF=y
```

## boards/native_sim.overlay
```dts
/*
 * SPDX-License-Identifier: Apache-2.0
 *
 * SIMULATION ONLY — nothing here describes hardware.
 *
 * `tests/fatal` is its own Zephyr application, rooted at tests/fatal, so it does
 * NOT see the application's boards/native_sim.overlay. Without this file the
 * alias 'reflow-ssr' does not exist on native_sim and heater.c stops the build
 * on its own guard — which would take down the `ztest (native_sim)` job, the one
 * that measures item 1 of the Definition of Done, the moment RFO-B44 is fixed.
 *
 * native_sim already provides a GPIO emulator as gpio0, so unlike the qemu_x86
 * overlay next to this one there is no controller to declare: only the SSR node
 * and the alias. Pin 15 and GPIO_ACTIVE_HIGH mirror the application's
 * boards/native_sim.overlay so both build the same shape.
 *
 * native_sim does not run on Windows (PROCESSO.md section 10), which is why the
 * qemu_x86 overlay exists as well. Both platforms build the same source and
 * assert the same thing; this one is what makes the suite measurable in CI.
 */

#include <zephyr/dt-bindings/gpio/gpio.h>

/ {
	reflow_outputs {
		compatible = "gpio-leds";

		ssr0: ssr_0 {
			gpios = <&gpio0 15 GPIO_ACTIVE_HIGH>;
			label = "SSR heater (emulated)";
		};
	};

	aliases {
		reflow-ssr = &ssr0;
	};
};
```

## src/main.c
```c
/*
 * SPDX-License-Identifier: Apache-2.0
 *
 * RFO-B44, the half that can assert on the gate.
 *
 * The other half is the reflow.fatal.panic scenario next to this one, which
 * fires a real k_panic() and is judged by the console harness. It has to be a
 * separate image for two reasons: ztest's own k_sys_fatal_error_handler is a
 * strong symbol that collides with fatal.c, and a genuine fatal error halts the
 * CPU, so nothing in that image can run an assertion afterwards. Between the
 * two: this suite proves the cut drives the gate low from the states that
 * matter, that one proves the handler is really reached when the CPU faults.
 *
 * Every test here starts from the gate HIGH. A test that started with the gate
 * low would pass on an empty function.
 */

#include <zephyr/drivers/gpio.h>
#include <zephyr/drivers/gpio/gpio_emul.h>
#include <zephyr/kernel.h>
#include <zephyr/ztest.h>

#include "heater.h"

#define SSR_NODE DT_ALIAS(reflow_ssr)

static const struct gpio_dt_spec ssr = GPIO_DT_SPEC_GET(SSR_NODE, gpios);

/* Drive the gate high through the real path: full duty, then one window tick. */
static void energise(void)
{
	zassert_ok(reflow_heater_init(), "heater init failed");

	reflow_heater_set_duty(1000);
	reflow_heater_tick(0);

	zassert_equal(gpio_emul_output_get(ssr.port, ssr.pin), 1,
		      "fixture is broken: the gate is not high before the cut, so "
		      "this test would pass on an empty function");
}

ZTEST(reflow_fatal, test_emergency_cut_drives_the_gate_low)
{
	energise();

	reflow_heater_emergency_off();

	zassert_equal(gpio_emul_output_get(ssr.port, ssr.pin), 0,
		      "the gate is still high after the emergency cut");
}

/*
 * The cut has to be idempotent: the fatal path can be re-entered (a fault while
 * handling a fault), and a second call must not undo the first.
 */
ZTEST(reflow_fatal, test_emergency_cut_is_idempotent)
{
	energise();

	reflow_heater_emergency_off();
	reflow_heater_emergency_off();

	zassert_equal(gpio_emul_output_get(ssr.port, ssr.pin), 0,
		      "the gate came back after a second cut");
	zassert_false(reflow_heater_is_on(), "the module still reports the output on");
}

/*
 * Same fixture check as tests/boot: the "physically low" readings above only
 * mean anything while this suite's own overlay declares GPIO_ACTIVE_HIGH. The
 * guarantee for the real boards is the BUILD_ASSERT in heater.c.
 */
ZTEST(reflow_fatal, test_inactive_means_physically_low)
{
	zassert_equal(ssr.dt_flags & GPIO_ACTIVE_LOW, 0,
		      "the SSR is declared active-low in this fixture; a low gate "
		      "would then mean the element is ON");
}

ZTEST_SUITE(reflow_fatal, NULL, NULL, NULL, NULL, NULL);
```

## src/panic.c
```c
/*
 * SPDX-License-Identifier: Apache-2.0
 *
 * RFO-B44, the half that fires a REAL fatal error.
 *
 * Not a ztest, and it cannot be one. ztest's own k_sys_fatal_error_handler
 * (CONFIG_ZTEST_FATAL_HOOK) is a strong symbol that would collide at link with
 * the one in src/core/fatal.c, and a genuine fatal error ends in
 * `Halting system` - the CPU stops, so no assertion can run afterwards inside
 * this image. What is left is the console, and that is enough for the one thing
 * this scenario has to establish: that the handler in fatal.c is the one the
 * kernel really reaches when a thread panics, and that it cuts.
 *
 * The gate is driven HIGH first, through the real path, and the level is printed
 * before the fault. A run that does not print `gate before the fault: 1` proves
 * nothing about what came after, so the harness requires that line too.
 *
 * The scenario is `ignore_faults: true` in testcase.yaml: the fatal error is the
 * subject, not an accident.
 */

#include <zephyr/drivers/gpio.h>
#include <zephyr/drivers/gpio/gpio_emul.h>
#include <zephyr/kernel.h>
#include <zephyr/sys/printk.h>

#include "heater.h"

#define SSR_NODE DT_ALIAS(reflow_ssr)

static const struct gpio_dt_spec ssr = GPIO_DT_SPEC_GET(SSR_NODE, gpios);

int main(void)
{
	int ret = reflow_heater_init();

	if (ret != 0) {
		printk("reflow-fatal: heater init failed: %d\n", ret);
		return 0;
	}

	/* The real path to a high gate: full duty, then one window tick. */
	reflow_heater_set_duty(1000);
	reflow_heater_tick(0);

	printk("reflow-fatal: gate before the fault: %d\n",
	       gpio_emul_output_get(ssr.port, ssr.pin));

	/*
	 * k_panic() and not a wild pointer: the ticket is about the DESTINATION
	 * of any fatal error, not about one cause, and a deliberate panic is the
	 * one cause that behaves identically on every platform this suite runs
	 * on. What it exercises is z_fatal_error() -> k_sys_fatal_error_handler,
	 * which is the same entry the CPU exception of RFO-B43 takes.
	 */
	k_panic();

	printk("reflow-fatal: still running after k_panic\n");
	return 0;
}
```
