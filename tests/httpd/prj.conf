## CMakeLists.txt
```
# SPDX-License-Identifier: Apache-2.0

cmake_minimum_required(VERSION 3.20.0)

# Same reason as tests/httpwait, tests/controller and tests/coldstart: reuse the
# application Kconfig so the test runs against the port, the client limit and
# the budgets the firmware ships with, instead of a restatement that can drift.
set(KCONFIG_ROOT ${CMAKE_CURRENT_SOURCE_DIR}/../../Kconfig)

find_package(Zephyr REQUIRED HINTS $ENV{ZEPHYR_BASE})
project(reflow_httpd_tests LANGUAGES C)

set(SRC  ${CMAKE_CURRENT_SOURCE_DIR}/../../src)
set(CORE ${SRC}/core)
set(FAKE ${CMAKE_CURRENT_SOURCE_DIR}/../controller/src)

# src/net/httpd.c is deliberately NOT here: src/main.c includes it, so that the
# test can reach send_all(), which is static and is where the RFO-B07 fix
# lives. Listing it as well would compile it twice and collide at link.
#
# Everything else is the firmware's own code, plus the two substitutions
# tests/httpwait already established: net_wait_fake.c for l4.c, because no link
# ever comes up on a simulated platform, and temp_fake.c for temp.c, because
# controller.c - which owns the telemetry channel httpd.c reads - needs a
# thermocouple that a simulated SPI bus does not have.
target_sources(app PRIVATE
  src/main.c
  src/socket_fake.c
  ${CMAKE_CURRENT_SOURCE_DIR}/../httpwait/src/net_wait_fake.c
  ${FAKE}/temp_fake.c
  ${SRC}/net/cmdparse.c
  ${SRC}/net/httpgate.c
  ${SRC}/net/profiles_json.c
  ${SRC}/net/sendbudget.c
  ${SRC}/telemetry_json.c
  ${CORE}/controller.c
  ${CORE}/heater.c
  ${CORE}/pid.c
  ${CORE}/profile.c
  ${CORE}/tempguard.c
)

# The link comes up on the first ask: this suite is not about the wait, and a
# server thread still waiting would be one more thing happening while the
# scenarios run. tests/httpwait is where the wait itself is measured.
target_compile_definitions(app PRIVATE REFLOW_NET_WAIT_FAKE_FAILURES=0)

# Same generated page as the firmware, from the same rule (RFO-B25): this image
# compiles httpd.c, so it needs index_html.h too.
include(${CMAKE_CURRENT_SOURCE_DIR}/../../cmake/index_html.cmake)
reflow_generate_index_html(${CMAKE_CURRENT_SOURCE_DIR}/../..)

target_include_directories(app PRIVATE ${SRC} ${CORE} ${SRC}/net ${FAKE}
                                       ${CMAKE_CURRENT_SOURCE_DIR}/src
                                       ${CMAKE_CURRENT_SOURCE_DIR}/../httpwait/src)
```

## prj.conf
```kconfig
CONFIG_ZTEST=y
CONFIG_ZBUS=y
CONFIG_GPIO=y
CONFIG_GPIO_EMUL=y

# The web UI is the subject here, so REFLOW_NET is on and brings its own
# networking dependencies through the application Kconfig. The display and the
# encoder are not in the image, for the reason tests/controller records.
CONFIG_REFLOW_NET=y
CONFIG_REFLOW_SHELL=n
CONFIG_REFLOW_UI_DISPLAY=n
CONFIG_REFLOW_UI_INPUT=n

# There is no radio and no USB host on a simulated platform: the only interface
# is the software loopback, which is enough to connect to the server the way a
# browser would. No link module is in the image either (see CMakeLists), so the
# Wi-Fi side of the Kconfig choice is inert here.
CONFIG_NET_LOOPBACK=y
CONFIG_NET_SOCKETS=y
CONFIG_NET_DHCPV4=n

# A remote command needs a token or the endpoint answers 503 (RFO-B02). This
# suite only reads telemetry, but leaving the token empty would make the one
# 503 answer indistinguishable from a route that is not there.
CONFIG_REFLOW_NET_TOKEN="testtoken"

# Loopback only, and no host-side networking backend. Left at their defaults,
# NETWORKING on these platforms brings up a SLIP/TAP link to the host: qemu is
# started with `-serial unix:/tmp/slip.sock`, which on this machine means the
# image produces no output at all, and native_sim wants a tap device the CI
# runner does not have. Upstream does the same thing for its loopback-only
# runs (samples/net/zperf/overlay-loopback-icount.conf).
# NET_LOOPBACK lives inside `if NET_DRIVERS` in drivers/net/Kconfig, so
# without this the symbol below is silently dropped and the image ends up
# with no interface at all: zsock_bind() on the wildcard address then fails
# with EADDRNOTAVAIL. It bit exactly one platform, because on qemu_x86
# something else already turns NET_DRIVERS on and on native_sim - with the
# tap driver off, below - nothing does.
CONFIG_NET_DRIVERS=y

CONFIG_NET_QEMU_SLIP=n
CONFIG_NET_SLIP_TAP=n
CONFIG_ETH_NATIVE_TAP=n

# The loopback driver delivers each packet synchronously in the sender's
# context, so the receive path runs nested on the caller's stack. Same reason
# and same order of magnitude as the upstream overlay above.
CONFIG_MAIN_STACK_SIZE=3072
CONFIG_ZTEST_STACK_SIZE=3072
CONFIG_NET_RX_STACK_SIZE=2560
CONFIG_NET_TX_STACK_SIZE=2560
CONFIG_NET_MGMT_EVENT_STACK_SIZE=2560
```

## src/main.c
```c
/*
 * SPDX-License-Identifier: Apache-2.0
 *
 * RFO-G42. First test that exercises src/net/httpd.c itself.
 *
 * The scenario is RFO-B07: a client that asks for the page and stops reading
 * it. On a blocking socket, from the server's only thread, zsock_send() parks
 * there for ever - the thread never returns to zsock_poll(), the event stream
 * stops for EVERY client, and the remote Stop button dies while the oven is at
 * 245 degC. One browser tab on a bad Wi-Fi is enough.
 *
 * Why the file is included rather than linked: send_all() is static, and it is
 * where the fix lives. Including httpd.c into this translation unit is what
 * lets the test call the real function instead of a copy of it - the lesson of
 * RFO-B24, where a test re-implemented what it claimed to measure. The
 * CMakeLists therefore does NOT list httpd.c in target_sources.
 *
 * Order matters in the three includes below and is not incidental:
 *
 *   1. <zephyr/net/socket.h> brings the real declarations in.
 *   2. socket_fake.h then redirects the NAMES.
 *   3. httpd.c is compiled with its call sites pointing at the fake, and with
 *      no other change - byte for byte the file that is flashed.
 */

#include <zephyr/net/socket.h>

#include "socket_fake.h"

#include <zephyr/kernel.h>
#include <zephyr/ztest.h>

#include "httpd.c"

/*
 * A body big enough that no peer swallows it in one call, and recognisably
 * bigger than one slice of a trickling one.
 */
#define BODY_LEN 64
static char body[BODY_LEN];

/*
 * The bound that says "the server thread came back". It is not a performance
 * assertion: SEND_BUDGET_MS is the contract, and three times it is generous
 * slack for a simulated platform under CI load. What it rules out is the only
 * failure that matters here - never coming back at all.
 */
#define RETURN_BOUND_MS (SEND_BUDGET_MS * 3)

static void setup_body(void)
{
	for (int i = 0; i < BODY_LEN; i++) {
		body[i] = 'x';
	}
}

static void *suite_setup(void)
{
	setup_body();
	return NULL;
}

static void scenario_reset(void *f)
{
	ARG_UNUSED(f);
	reflow_fake_reset();
}

/*
 * THE test of this ticket. A peer that never accepts a byte must cost the
 * server a bounded amount of time and then be given up on.
 *
 * Both halves are asserted, and the second is the one that would be missed:
 * returning is not enough if it took for ever to do it, and giving up is not
 * enough if the server kept the socket.
 */
ZTEST(reflow_httpd, test_a_client_that_stops_reading_does_not_park_the_server)
{
	int fd = reflow_fake_open(REFLOW_FAKE_PEER_STALLED);
	int64_t t0, elapsed;
	int ret;

	zassert_true(fd >= 0, "fixture: no fake descriptor available");

	t0 = k_uptime_get();
	ret = send_all(fd, body, BODY_LEN);
	elapsed = k_uptime_get() - t0;

	zassert_not_equal(ret, 0,
			  "send_all() reported success to a peer that accepted "
			  "zero bytes");

	zassert_true(elapsed < RETURN_BOUND_MS,
		     "send_all() held the server thread for %lld ms against a "
		     "budget of %d ms. This is RFO-B07: the thread never gets "
		     "back to zsock_poll(), so the event stream stops for every "
		     "client and the remote Stop button is gone",
		     elapsed, SEND_BUDGET_MS);

	zassert_equal(reflow_fake_accepted(fd), 0U,
		      "fixture: the stalled peer accepted %zu bytes",
		      reflow_fake_accepted(fd));
}

/*
 * The other half of RFO-B07, and the half that separates a real fix from a
 * timer on the connection: a peer that reads slowly but KEEPS reading must
 * never be dropped, however long the transfer takes.
 *
 * At one byte per slice, this transfer lasts BODY_LEN * 100 ms - far past the
 * budget - and it has to succeed. A fix that counted time on the connection
 * instead of time without progress would pass the test above and fail here.
 */
ZTEST(reflow_httpd, test_a_slow_but_progressing_client_is_never_dropped)
{
	int fd = reflow_fake_open(REFLOW_FAKE_PEER_TRICKLE);
	int64_t t0, elapsed;
	int ret;

	zassert_true(fd >= 0, "fixture: no fake descriptor available");

	t0 = k_uptime_get();
	ret = send_all(fd, body, BODY_LEN);
	elapsed = k_uptime_get() - t0;

	zassert_equal(ret, 0,
		      "send_all() gave up on a peer that was still accepting "
		      "bytes: the budget is measuring time on the connection "
		      "instead of time without progress (RFO-B07)");

	zassert_equal(reflow_fake_accepted(fd), (size_t)BODY_LEN,
		      "the peer accepted %zu of %d bytes",
		      reflow_fake_accepted(fd), BODY_LEN);

	zassert_true(elapsed > SEND_BUDGET_MS,
		     "fixture: the transfer took %lld ms, which is not longer "
		     "than the %d ms budget - this scenario only proves "
		     "something if it outlives the deadline",
		     elapsed, SEND_BUDGET_MS);
}

/* The healthy client, so the two above are not the only shapes measured. */
ZTEST(reflow_httpd, test_a_fast_client_gets_everything)
{
	int fd = reflow_fake_open(REFLOW_FAKE_PEER_FAST);

	zassert_true(fd >= 0, "fixture: no fake descriptor available");
	zassert_equal(send_all(fd, body, BODY_LEN), 0, "send_all() failed");
	zassert_equal(reflow_fake_accepted(fd), (size_t)BODY_LEN,
		      "the peer accepted %zu of %d bytes",
		      reflow_fake_accepted(fd), BODY_LEN);
}

/*
 * ---------------------------------------------------------------------------
 * RFO-B30. The length build_state_json() reports.
 *
 * snprintk() returns the length of the string it was ASKED to produce, not of
 * the one it produced. Both callers hand that number straight to send_all()
 * as a byte count, so on truncation the server reads past a 384 byte array on
 * its own thread stack and sends what follows it to the client. Not a
 * corrupted page: a stack leak over the network, on the interface anything in
 * cable or radio range can reach.
 *
 * Reached here by shrinking the buffer rather than by lengthening a name. The
 * issue describes the defect becoming reachable when some stage, profile or
 * fault name grows past the slack in REFLOW_JSON_BUF_SZ, and that is true -
 * but it is the same arithmetic from the other side, and it is the arithmetic
 * that is wrong. A test that needed a longer name would also need the
 * built-in table changed to produce one, which measures the table instead of
 * the clamp.
 * ---------------------------------------------------------------------------
 */

/*
 * A buffer with a known pattern on both sides of the part the code may touch.
 * If the clamp is missing the assertions below fail on the returned length
 * alone, but the canary is what distinguishes "reported too much" from
 * "wrote too much", and only one of those two is a memory bug.
 */
#define CANARY 0x5a
#define PAD    32

struct guarded {
	unsigned char before[PAD];
	char body[JSON_BUF_SZ];
	unsigned char after[PAD];
};

static void guarded_init(struct guarded *g)
{
	memset(g, CANARY, sizeof(*g));
}

static void guarded_check(const struct guarded *g, size_t cap)
{
	size_t i;

	for (i = 0; i < PAD; i++) {
		zassert_equal(g->before[i], CANARY,
			      "wrote %zu bytes BEFORE the buffer", PAD - i);
		zassert_equal(g->after[i], CANARY,
			      "wrote past the end of the buffer at +%zu", i);
	}
	for (i = cap; i < sizeof(g->body); i++) {
		zassert_equal((unsigned char)g->body[i], CANARY,
			      "wrote past the cap it was given, at +%zu", i - cap);
	}
}

/*
 * THE assertion of this ticket, and it is about the RETURN VALUE, because the
 * return value is what becomes a byte count.
 *
 * Every cap from one byte to comfortably more than the object needs. One of
 * them is the boundary where the text stops fitting, and an off-by-one in the
 * clamp shows up here instead of on a board.
 */
ZTEST(reflow_httpd, test_the_reported_length_is_never_more_than_was_written)
{
	size_t cap;

	for (cap = 1; cap <= JSON_BUF_SZ; cap++) {
		struct guarded g;
		int n;

		guarded_init(&g);
		n = build_state_json(g.body, cap);

		zassert_true(n >= 0, "cap %zu: negative length %d", cap, n);
		zassert_true((size_t)n < cap,
			     "cap %zu: reported %d bytes, which is what snprintk "
			     "WOULD have written - send_all() takes this as a "
			     "byte count and reads %zu bytes past a buffer on "
			     "the server's own stack, out to the client "
			     "(RFO-B30)",
			     cap, n, (size_t)n - cap + 1U);
		zassert_equal((size_t)n, strlen(g.body),
			      "cap %zu: reported %d but the string is %zu long",
			      cap, n, strlen(g.body));
		guarded_check(&g, cap);
	}
}

/*
 * The other half, so the clamp cannot be satisfied by always returning zero:
 * at a comfortable size the answer is the whole object, not a truncation.
 */
ZTEST(reflow_httpd, test_a_comfortable_buffer_gets_the_whole_object)
{
	struct guarded g;
	int n;

	guarded_init(&g);
	n = build_state_json(g.body, sizeof(g.body));

	zassert_true(n > 0, "nothing was written into a full-size buffer");
	zassert_equal((size_t)n, strlen(g.body), "length disagrees with the string");
	zassert_equal(g.body[0], '{', "not a JSON object: %s", g.body);
	zassert_equal(g.body[n - 1], '}', "the object is not closed: %s", g.body);
	zassert_not_null(strstr(g.body, "temp_mc"), "no telemetry in it: %s", g.body);
	guarded_check(&g, sizeof(g.body));
}

/*
 * A truncated object is still terminated. The clamp exists so the LENGTH is
 * honest; this is the companion property the length is useless without,
 * because send_response() and the %s in push_event() both read the buffer as
 * a C string.
 */
ZTEST(reflow_httpd, test_a_truncated_object_is_still_a_string)
{
	struct guarded g;
	int n;

	guarded_init(&g);
	n = build_state_json(g.body, 16);

	zassert_true((size_t)n < 16U, "reported %d for a 16 byte buffer", n);
	zassert_equal(g.body[n], '\0',
		      "the buffer is not terminated at the length returned");
	guarded_check(&g, 16);
}

ZTEST_SUITE(reflow_httpd, NULL, suite_setup, scenario_reset, NULL, NULL);
```

## src/socket_fake.c
```c
/*
 * SPDX-License-Identifier: Apache-2.0
 *
 * RFO-G42. See socket_fake.h for why the substitution is at the call site.
 *
 * This file does NOT include socket_fake.h's redirection - it defines the
 * functions the redirection points at, and renaming them here would rename the
 * definitions too.
 */

#include <errno.h>
#include <stdbool.h>
#include <stddef.h>
#include <sys/types.h>

#include <zephyr/kernel.h>

#include "socket_fake.h"

#define FAKE_FDS 8

struct fake_sock {
	bool open;
	enum reflow_fake_peer peer;
	size_t accepted;
	bool closed;
	bool stall_next;
};

static struct fake_sock socks[FAKE_FDS];

void reflow_fake_reset(void)
{
	for (int i = 0; i < FAKE_FDS; i++) {
		socks[i].open = false;
		socks[i].peer = REFLOW_FAKE_PEER_FAST;
		socks[i].accepted = 0U;
		socks[i].closed = false;
		socks[i].stall_next = false;
	}
}

int reflow_fake_open(enum reflow_fake_peer peer)
{
	for (int i = 0; i < FAKE_FDS; i++) {
		if (!socks[i].open) {
			socks[i].open = true;
			socks[i].peer = peer;
			socks[i].accepted = 0U;
			socks[i].closed = false;
			socks[i].stall_next = false;
			return i;
		}
	}
	return -1;
}

size_t reflow_fake_accepted(int fd)
{
	return (fd >= 0 && fd < FAKE_FDS) ? socks[fd].accepted : 0U;
}

bool reflow_fake_closed(int fd)
{
	return (fd >= 0 && fd < FAKE_FDS) ? socks[fd].closed : false;
}

/*
 * The one call that matters for RFO-B07.
 *
 * A stalled peer costs a slice and answers EAGAIN, exactly as a real socket
 * with SO_SNDTIMEO does when the receive window stays full. The slice is what
 * makes the scenario measurable in wall time instead of in iterations, and it
 * is also what the server's retry loop is written against - send_all() has no
 * sleep of its own, because the blocking send IS the sleep.
 */
ssize_t reflow_fake_send(int sock, const void *buf, size_t len, int flags)
{
	ARG_UNUSED(buf);
	ARG_UNUSED(flags);

	if (sock < 0 || sock >= FAKE_FDS || !socks[sock].open) {
		errno = EBADF;
		return -1;
	}
	if (len == 0U) {
		return 0;
	}

	switch (socks[sock].peer) {
	case REFLOW_FAKE_PEER_FAST:
		socks[sock].accepted += len;
		return (ssize_t)len;

	case REFLOW_FAKE_PEER_TRICKLE:
		/*
		 * ALTERNATES, and that is the whole point of this mode rather
		 * than a detail of it. A peer that returned a byte on every
		 * call would never take send_all() into its EAGAIN branch, so
		 * the budget would never be consulted and this scenario would
		 * be blind to what it exists to measure - the first version of
		 * this fake did exactly that, and the mutation stayed GREEN.
		 *
		 * A real window that is nearly full behaves this way: a little
		 * room, then none, then a little more.
		 */
		k_sleep(K_MSEC(REFLOW_FAKE_SLICE_MS));
		socks[sock].stall_next = !socks[sock].stall_next;
		if (socks[sock].stall_next) {
			socks[sock].accepted += 1U;
			return 1;
		}
		errno = EAGAIN;
		return -1;

	case REFLOW_FAKE_PEER_STALLED:
	default:
		k_sleep(K_MSEC(REFLOW_FAKE_SLICE_MS));
		errno = EAGAIN;
		return -1;
	}
}

ssize_t reflow_fake_recv(int sock, void *buf, size_t max_len, int flags)
{
	ARG_UNUSED(buf);
	ARG_UNUSED(max_len);
	ARG_UNUSED(flags);

	if (sock < 0 || sock >= FAKE_FDS || !socks[sock].open) {
		errno = EBADF;
		return -1;
	}
	/* Nothing to read: the peer of this suite never speaks first. */
	return 0;
}

int reflow_fake_close(int sock)
{
	if (sock >= 0 && sock < FAKE_FDS && socks[sock].open) {
		socks[sock].closed = true;
		socks[sock].open = false;
	}
	return 0;
}

/*
 * Refused on purpose, and it is what keeps the image quiet: httpd_thread()
 * gives up and returns when listen_socket() fails, so the server thread never
 * enters its poll loop and the scenarios below have the fake to themselves.
 *
 * The accept loop and the multi-client event stream are therefore NOT reached
 * by this suite. That is a real limit and the PR says so - it is the dato that
 * decides whether the next tickets can use this harness or need another one.
 */
int reflow_fake_socket(int family, int type, int proto)
{
	ARG_UNUSED(family);
	ARG_UNUSED(type);
	ARG_UNUSED(proto);

	errno = EAFNOSUPPORT;
	return -1;
}
```

## src/socket_fake.h
```c
/*
 * SPDX-License-Identifier: Apache-2.0
 *
 * A socket the test drives, in place of the one the kernel provides.
 *
 * RFO-G42. httpd.c is the file with the longest list of closed defects in this
 * project - B07, B08, B09, B14, B15/G32, B30, B33, B43 - and every one of them
 * was found by reading the code, none by a test that failed first. What stood
 * in the way is that the interesting decisions live between the socket calls,
 * and a real socket cannot be asked to stall on command: tests/httpwait talks
 * over the loopback driver, which is faithful but gives the test no say over
 * when a peer stops reading.
 *
 * So the substitution is at the call, not at the link. main.c includes
 * <zephyr/net/socket.h> FIRST - the real declarations go in untouched - and
 * only then this header, so the names below redirect httpd.c's CALL SITES and
 * nothing else. httpd.c is compiled exactly as it is flashed, with no #ifdef
 * for the test and no change to the file. The one thing faked is the kernel on
 * the other side of the call.
 *
 * Deliberately not a general socket emulator: it answers the calls httpd.c
 * makes, in the shapes this suite needs, and nothing more.
 */

#ifndef REFLOW_SOCKET_FAKE_H_
#define REFLOW_SOCKET_FAKE_H_

#include <stddef.h>
#include <sys/types.h>

/* What the peer on the other end does with what the server sends it. */
enum reflow_fake_peer {
	/* Reads everything immediately: the healthy client. */
	REFLOW_FAKE_PEER_FAST,
	/*
	 * Stopped reading. Every send answers EAGAIN after a slice, which is
	 * what a real socket carrying SO_SNDTIMEO does once the peer's receive
	 * window is full. This is the RFO-B07 client: one browser tab on a bad
	 * Wi-Fi, nothing malicious needed.
	 */
	REFLOW_FAKE_PEER_STALLED,
	/*
	 * Reads, but barely: one byte per slice. The transfer takes far longer
	 * than the budget, and the server must NOT drop it - the budget
	 * measures time without progress, not time on the connection. This is
	 * the case that tells a correct fix from one that just counts seconds.
	 */
	REFLOW_FAKE_PEER_TRICKLE,
};

/* Hand out a descriptor whose peer behaves this way. */
int reflow_fake_open(enum reflow_fake_peer peer);

/* Bytes this descriptor has actually accepted since it was opened. */
size_t reflow_fake_accepted(int fd);

/* True once the server closed it. */
bool reflow_fake_closed(int fd);

/*
 * How long a send that cannot make progress blocks before answering EAGAIN.
 * It mirrors the SO_SNDTIMEO httpd.c sets on every accepted socket: without
 * it the server's retry loop would spin at the speed of the host and the
 * budget would expire in a number of iterations nobody can reason about.
 */
#define REFLOW_FAKE_SLICE_MS 100

/* Forget every descriptor. Called between scenarios. */
void reflow_fake_reset(void);

ssize_t reflow_fake_send(int sock, const void *buf, size_t len, int flags);
ssize_t reflow_fake_recv(int sock, void *buf, size_t max_len, int flags);
int reflow_fake_close(int sock);
int reflow_fake_socket(int family, int type, int proto);

/*
 * The redirection itself. Below this line, inside httpd.c, these names mean
 * the functions above.
 */
#define zsock_send   reflow_fake_send
#define zsock_recv   reflow_fake_recv
#define zsock_close  reflow_fake_close
#define zsock_socket reflow_fake_socket

#endif /* REFLOW_SOCKET_FAKE_H_ */
```
