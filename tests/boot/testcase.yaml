## tests/boot/testcase.yaml
```yaml
tests:
  reflow.boot:
    platform_allow:
      - native_sim
      - qemu_x86
    tags:
      - reflow
      - heater
      - seguranca
```

## tests/logic/testcase.yaml
```yaml
tests:
  reflow.logic:
    platform_allow:
      - native_sim
      - qemu_x86
    tags: reflow pid profile
```
