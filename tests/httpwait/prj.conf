## CMakeLists.txt
```
# SPDX-License-Identifier: Apache-2.0

cmake_minimum_required(VERSION 3.20.0)

# Same reason as tests/boot, tests/controller and tests/coldstart: reuse the
# application Kconfig so the test runs against the port, the client limit and
# the budgets the firmware ships with, instead of a restatement that can drift.
set(KCONFIG_ROOT ${CMAKE_CURRENT_SOURCE_DIR}/../../Kconfig)

find_package(Zephyr REQUIRED HINTS $ENV{ZEPHYR_BASE})
project(reflow_httpwait_tests LANGUAGES C)

set(SRC  ${CMAKE_CURRENT_SOURCE_DIR}/../../src)
set(CORE ${SRC}/core)
set(FAKE ${CMAKE_CURRENT_SOURCE_DIR}/../controller/src)

# httpd.c exactly as it is flashed, with two substitutions at link time:
#
#   - net_wait_fake.c takes the place of ${SRC}/net/l4.c. l4.c is the file that
#     talks to the network stack's event callbacks, and on a simulated platform
#     no link ever comes up, so every wait would be a real timeout.
#   - temp_fake.c takes the place of ${CORE}/temp.c, shared with tests/controller
#     rather than copied. httpd.c needs the telemetry channel and
#     reflow_cmd_post(), which live in controller.c, and controller.c needs a
#     thermocouple that a simulated SPI bus does not have.
#
# The link module (wifi.c / usb_net.c) is NOT in the image: the wait under test
# is link-agnostic by design, which is the property l4.c exists to provide.
target_sources(app PRIVATE
  src/main.c
  src/net_wait_fake.c
  ${FAKE}/temp_fake.c
  ${SRC}/net/httpd.c
  ${SRC}/net/cmdparse.c
  ${SRC}/net/httpgate.c
  ${SRC}/net/profiles_json.c
  ${SRC}/net/sendbudget.c
  ${SRC}/telemetry_json.c
  ${CORE}/controller.c
  ${CORE}/heater.c
  ${CORE}/pid.c
  ${CORE}/profile.c
  ${CORE}/tempguard.c
)

#
# This is the whole point of this directory: the link is NOT up when the httpd
# thread first runs, and comes up afterwards. It has to be a build-time value,
# because the thread waits from K_THREAD_DEFINE before any test body could set
# anything (see tests/coldstart, and the lesson of RFO-G17).
#
# Two failures, not one: one would be satisfied by a server that retries
# exactly once, which is a different bug with the same shape.
#
target_compile_definitions(app PRIVATE REFLOW_NET_WAIT_FAKE_FAILURES=2)

# Same generated page as the firmware, from the same rule (RFO-B25): this
# image links httpd.c, so it needs index_html.h too, and a second copy of
# the recipe here is a second thing to drift.
include(${CMAKE_CURRENT_SOURCE_DIR}/../../cmake/index_html.cmake)
reflow_generate_index_html(${CMAKE_CURRENT_SOURCE_DIR}/../..)

target_include_directories(app PRIVATE ${SRC} ${CORE} ${SRC}/net ${FAKE}
                                       ${CMAKE_CURRENT_SOURCE_DIR}/src)
```

## prj.conf
```kconfig
CONFIG_ZTEST=y
CONFIG_ZBUS=y
CONFIG_GPIO=y
CONFIG_GPIO_EMUL=y

# The web UI is the subject here, so REFLOW_NET is on and brings its own
# networking dependencies through the application Kconfig. The display and the
# encoder are not in the image, for the reason tests/controller records.
CONFIG_REFLOW_NET=y
CONFIG_REFLOW_SHELL=n
CONFIG_REFLOW_UI_DISPLAY=n
CONFIG_REFLOW_UI_INPUT=n

# There is no radio and no USB host on a simulated platform: the only interface
# is the software loopback, which is enough to connect to the server the way a
# browser would. No link module is in the image either (see CMakeLists), so the
# Wi-Fi side of the Kconfig choice is inert here.
CONFIG_NET_LOOPBACK=y
CONFIG_NET_SOCKETS=y
CONFIG_NET_DHCPV4=n

# A remote command needs a token or the endpoint answers 503 (RFO-B02). This
# suite only reads telemetry, but leaving the token empty would make the one
# 503 answer indistinguishable from a route that is not there.
CONFIG_REFLOW_NET_TOKEN="testtoken"

# Loopback only, and no host-side networking backend. Left at their defaults,
# NETWORKING on these platforms brings up a SLIP/TAP link to the host: qemu is
# started with `-serial unix:/tmp/slip.sock`, which on this machine means the
# image produces no output at all, and native_sim wants a tap device the CI
# runner does not have. Upstream does the same thing for its loopback-only
# runs (samples/net/zperf/overlay-loopback-icount.conf).
CONFIG_NET_QEMU_SLIP=n
CONFIG_NET_SLIP_TAP=n
CONFIG_ETH_NATIVE_TAP=n

# The loopback driver delivers each packet synchronously in the sender's
# context, so the receive path runs nested on the caller's stack. Same reason
# and same order of magnitude as the upstream overlay above.
CONFIG_MAIN_STACK_SIZE=3072
CONFIG_ZTEST_STACK_SIZE=3072
CONFIG_NET_RX_STACK_SIZE=2560
CONFIG_NET_TX_STACK_SIZE=2560
CONFIG_NET_MGMT_EVENT_STACK_SIZE=2560
```

## src/main.c
```c
/*
 * SPDX-License-Identifier: Apache-2.0
 *
 * RFO-B11: an oven whose link comes up late has to end up with a working web
 * UI, without a reboot.
 *
 * This is its own image, not a test in tests/controller, for the reason
 * tests/boot and tests/coldstart are their own images: the property is about
 * the state the httpd thread starts in. It waits for the link from
 * K_THREAD_DEFINE, before any test body can influence anything, so the
 * influence is a build-time value - REFLOW_NET_WAIT_FAKE_FAILURES=2 in this
 * directory's CMakeLists - and the whole image is built around a link that is
 * down at boot and appears afterwards.
 *
 * What the old code did: reflow_net_wait_ready(K_MINUTES(5)) once, and on
 * timeout the thread returned. No listening socket for the rest of the
 * session, so no page, no event stream and no remote Stop - on a mains heater,
 * with the local UI as the only way to intervene.
 *
 * The two tests below are deliberately different questions:
 *
 *   - the first one asks whether the thread came back to the gate at all. It
 *     is the direct negation of "return on timeout" and it needs no socket.
 *   - the second one asks the acceptance criterion, end to end: a client that
 *     shows up after the late link gets telemetry over a real socket. A server
 *     that looped but never reached listen_socket() would pass the first and
 *     fail this one.
 */

#include <errno.h>
#include <string.h>

#include <zephyr/kernel.h>
#include <zephyr/net/socket.h>
#include <zephyr/ztest.h>

#include "app.h"
#include "net_wait_fake.h"

/*
 * Every failed wait costs the fake's compressed timeout, and after the last one
 * the thread still has to create the socket and reach zsock_poll(). Give the
 * waits several times both.
 */
#define SETTLE_MS 5000
#define POLL_MS   50

static bool wait_for(bool (*done)(void), int64_t budget_ms)
{
	int64_t deadline = k_uptime_get() + budget_ms;

	while (true) {
		if (done()) {
			return true;
		}
		if (k_uptime_get() >= deadline) {
			return false;
		}
		k_msleep(POLL_MS);
	}
}

static bool came_back_to_the_gate(void)
{
	return reflow_net_wait_fake_calls() > REFLOW_NET_WAIT_FAKE_FAILURES;
}

/*
 * The gate is asked again after a timeout instead of the thread returning.
 *
 * REFLOW_NET_WAIT_FAKE_FAILURES timeouts, so a server that gives up on the
 * first one is stuck at 1 call, and one that retries a fixed number of times
 * stops at that number. The count has to pass the failures for the link to
 * have been seen at all.
 */
ZTEST(reflow_httpwait, test_espera_do_link_nao_desiste_no_timeout)
{
	zassert_true(wait_for(came_back_to_the_gate, SETTLE_MS),
		     "o servidor desistiu do link: %u chamadas a "
		     "reflow_net_wait_ready() para %u timeouts",
		     reflow_net_wait_fake_calls(),
		     (unsigned int)REFLOW_NET_WAIT_FAKE_FAILURES);
}

static int get_state(char *buf, size_t len)
{
	static const char req[] = "GET /api/state HTTP/1.1\r\n"
				  "Host: oven\r\n"
				  "Connection: close\r\n\r\n";
	struct sockaddr_in addr = {
		.sin_family = AF_INET,
		.sin_port = htons(CONFIG_REFLOW_NET_HTTP_PORT),
	};
	size_t got = 0;
	int fd, ret;

	if (zsock_inet_pton(AF_INET, "127.0.0.1", &addr.sin_addr) != 1) {
		return -EINVAL;
	}

	fd = zsock_socket(AF_INET, SOCK_STREAM, IPPROTO_TCP);
	if (fd < 0) {
		return -errno;
	}

	if (zsock_connect(fd, (struct sockaddr *)&addr, sizeof(addr)) < 0) {
		ret = -errno;
		zsock_close(fd);
		return ret;
	}

	if (zsock_send(fd, req, sizeof(req) - 1, 0) < 0) {
		ret = -errno;
		zsock_close(fd);
		return ret;
	}

	while (got + 1 < len) {
		ret = zsock_recv(fd, &buf[got], len - got - 1, 0);
		if (ret <= 0) {
			break;
		}
		got += (size_t)ret;
	}
	buf[got] = '\0';
	zsock_close(fd);

	return (int)got;
}

static bool server_is_listening(void)
{
	char buf[256];

	return get_state(buf, sizeof(buf)) > 0;
}

/*
 * The acceptance criterion of the issue: the client that arrives after the
 * link came up late is served. Without the patch there is nothing on the port
 * at all and this fails at connect().
 */
ZTEST(reflow_httpwait, test_ui_web_funciona_com_link_atrasado)
{
	char buf[512];
	int n;

	zassert_true(wait_for(reflow_net_wait_fake_stack_ready, SETTLE_MS),
		     "a imagem nao tem interface para escutar: 127.0.0.1 nao esta "
		     "registrado. Isso e configuracao desta suite (NET_DRIVERS, "
		     "NET_LOOPBACK), nao o servidor");
	zassert_true(wait_for(server_is_listening, SETTLE_MS),
		     "nada escutando em :%d depois de %d ms",
		     CONFIG_REFLOW_NET_HTTP_PORT, SETTLE_MS);

	n = get_state(buf, sizeof(buf));
	zassert_true(n > 0, "GET /api/state falhou: %d", n);
	zassert_not_null(strstr(buf, "200 OK"), "resposta sem 200: %s", buf);
	zassert_not_null(strstr(buf, "\"temp_mc\":"),
			 "resposta sem telemetria: %s", buf);
}

ZTEST_SUITE(reflow_httpwait, NULL, NULL, NULL, NULL, NULL);
```

## src/net_wait_fake.c
```c
/*
 * SPDX-License-Identifier: Apache-2.0
 *
 * See net_wait_fake.h.
 */

#include <errno.h>

#include <zephyr/kernel.h>
#include <zephyr/net/net_if.h>
#include <zephyr/net/net_ip.h>

#include "net.h"
#include "net_wait_fake.h"

/*
 * A failed wait has to cost time, or the loop under test spins as fast as the
 * scheduler allows and the image looks broken for the wrong reason. It must
 * not cost the real CONFIG-free K_MINUTES(5) either, or the suite would take a
 * quarter of an hour to prove a loop.
 *
 * So the timeout the caller asks for is deliberately ignored and compressed to
 * this. What the test measures is how many times the caller comes back, not
 * how long Zephyr's semaphore takes to expire - k_sem_take() with a timeout is
 * not the code under test.
 */
#define FAKE_TIMEOUT_MS 200

static atomic_t calls;

/*
 * What net.h promises the caller: "0 once the stack has an address". l4.c can
 * only return 0 after NET_EVENT_L4_CONNECTED, which by construction means an
 * interface that is up with an address on it.
 *
 * The fake has to honour the same promise or it hands httpd.c a link that does
 * not exist yet: zsock_bind() on the wildcard address resolves through the
 * default interface, and before that interface is up the bind fails with
 * EADDRNOTAVAIL. That is not the behaviour under test, it is the fake lying,
 * and it showed up as a platform difference - on native_sim the image reaches
 * the bind far sooner in simulated time than on qemu_x86.
 */
static bool stack_has_an_address(void)
{
	static const struct net_in_addr loopback = NET_INADDR_LOOPBACK_INIT;
	struct net_if *iface = NULL;

	if (net_if_ipv4_addr_lookup(&loopback, &iface) == NULL) {
		return false;
	}

	return iface != NULL && net_if_is_up(iface);
}

int reflow_net_wait_ready(k_timeout_t timeout)
{
	atomic_val_t n = atomic_inc(&calls);

	ARG_UNUSED(timeout);

	if (n < REFLOW_NET_WAIT_FAKE_FAILURES || !stack_has_an_address()) {
		k_sleep(K_MSEC(FAKE_TIMEOUT_MS));
		return -EAGAIN;
	}

	return 0;
}

uint32_t reflow_net_wait_fake_calls(void)
{
	return (uint32_t)atomic_get(&calls);
}

bool reflow_net_wait_fake_stack_ready(void)
{
	return stack_has_an_address();
}
```

## src/net_wait_fake.h
```c
/*
 * SPDX-License-Identifier: Apache-2.0
 *
 * Injectable link gate for the httpd suite (RFO-B11).
 *
 * This file provides the net.h contract in place of src/net/l4.c, so httpd.c
 * can be linked into a test image whose link never comes up on its own. l4.c
 * is the file that listens to NET_EVENT_L4_* and holds the semaphore; there is
 * no Wi-Fi radio and no USB host behind a simulated platform, so the semaphore
 * would never be given and every wait here would be a real timeout.
 *
 * Same reasoning as tests/controller/src/temp_fake.c, and the same limit: the
 * substitution happens at link time, in this directory's CMakeLists, so no
 * shipped image can contain it.
 */

#ifndef REFLOW_NET_WAIT_FAKE_H_
#define REFLOW_NET_WAIT_FAKE_H_

#include <stdbool.h>
#include <stdint.h>

/*
 * How many reflow_net_wait_ready() calls report a timeout before the link is
 * declared usable.
 *
 * Set at BUILD time - see this directory's CMakeLists.txt - and deliberately
 * not at runtime, for the reason tests/coldstart records: the httpd thread
 * runs its wait from K_THREAD_DEFINE, before any test body or setup hook could
 * write a knob. A runtime knob would advertise a capability it does not have
 * (RFO-G17).
 */
#ifndef REFLOW_NET_WAIT_FAKE_FAILURES
#define REFLOW_NET_WAIT_FAKE_FAILURES 0
#endif

/* How many times reflow_net_wait_ready() has been called. */
uint32_t reflow_net_wait_fake_calls(void);

/*
 * Whether the image has an interface the server could bind to - the
 * condition the fake itself waits for. Exposed so a test can tell the two
 * failures apart: a server that gave up on the link, and an image whose
 * network stack was never there (a Kconfig regression, not a firmware one).
 */
bool reflow_net_wait_fake_stack_ready(void);

#endif /* REFLOW_NET_WAIT_FAKE_H_ */
```
